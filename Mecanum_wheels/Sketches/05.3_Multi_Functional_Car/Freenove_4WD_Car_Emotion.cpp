#include <Arduino.h>
#include "Freenove_VK16K33_Lib.h"
#include "Freenove_4WD_Car_For_Pico_W.h"
#include "Freenove_4WD_Car_Emotion.h"

// ============================================================================
// THIS FILE: the robot's "face" - two 8x8 LED matrices side by side, driven
// by the Freenove_VK16K33 library.
//
// Below are a bunch of byte arrays like `eyeRotate1[][8]`. Each group of 8
// numbers is ONE animation frame: each number is one row of 8 pixels on the
// matrix, and each bit in that number (in binary) says whether that pixel
// is lit or not. For example 0x3C is binary 00111100, meaning the middle 4
// pixels of that row are lit. You don't need to decode these by hand - just
// know that "an array of 8-number groups" = "a flip-book of animation
// frames" that gets played back frame-by-frame further down in this file.
// ============================================================================

//Turn eyes clockwise
byte eyeRotate1[][8]  = {
  0x00, 0x3C, 0x4E, 0x4E, 0x7E, 0x7E, 0x3C, 0x00,
  0x00, 0x3C, 0x66, 0x66, 0x7E, 0x7E, 0x3C, 0x00,
  0x00, 0x3C, 0x72, 0x72, 0x7E, 0x7E, 0x3C, 0x00,
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  0x00, 0x3C, 0x7E, 0x4E, 0x4E, 0x7E, 0x3C, 0x00,
};

//Turn eyes counterclockwise
byte eyeRotate2[][8] = {
  0x00, 0x3C, 0x72, 0x72, 0x7E, 0x7E, 0x3C, 0x00,
  0x00, 0x3C, 0x66, 0x66, 0x7E, 0x7E, 0x3C, 0x00,
  0x00, 0x3C, 0x4E, 0x4E, 0x7E, 0x7E, 0x3C, 0x00,
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  0x00, 0x3C, 0x7E, 0x72, 0x72, 0x7E, 0x3C, 0x00,
};

//Blink eyes
byte eyeBlink[][8] = {
  0x00, 0x00, 0x3C, 0x66, 0x42, 0x66, 0x3C, 0x00,
  0x00, 0x00, 0x3C, 0x7E, 0x42, 0x66, 0x3C, 0x00,
  0x00, 0x00, 0x3C, 0x7E, 0x7E, 0x7E, 0x3C, 0x00,
  0x00, 0x00, 0x3C, 0x7E, 0x42, 0x66, 0x3C, 0x00,
  0x00, 0x00, 0x3C, 0x7E, 0x7E, 0x7E, 0x3C, 0x00,
};

//keep smile
byte eyeSmile[][8] = {
  0x00, 0x00, 0x18, 0x24, 0x42, 0x00, 0x00, 0x00,
  0x00, 0x18, 0x24, 0x42, 0x00, 0x00, 0x00, 0x00,
};

//cry-left
byte eyeCry1[][8] = {
  0x00, 0x00, 0x7E, 0x3C, 0x00, 0x00, 0x00, 0x00,
  0x00, 0x00, 0x7E, 0x3C, 0x18, 0x00, 0x00, 0x00,
  0x00, 0x00, 0x7E, 0x3C, 0x00, 0x18, 0x00, 0x00,
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  0x00, 0x00, 0x7E, 0x3C, 0x00, 0x00, 0x00, 0x00,
};

//cry-right
byte eyeCry2[][8] = {
  0x00, 0x00, 0x7E, 0x3C, 0x00, 0x00, 0x00, 0x00,
  0x00, 0x00, 0x7E, 0x3C, 0x00, 0x00, 0x00, 0x00,
  0x00, 0x00, 0x7E, 0x3C, 0x00, 0x00, 0x00, 0x00,
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  0x00, 0x00, 0x7E, 0x3C, 0x00, 0x00, 0x00, 0x00,
};

//wheel-left
byte wheel_left[][8] =
{
  0x18, 0x10, 0x10, 0x9F, 0xF9, 0x08, 0x08, 0x18,
  0x20, 0x42, 0x25, 0x18, 0x18, 0xA4, 0x42, 0x04,
  0x0C, 0x08, 0x88, 0xF8, 0x1F, 0x11, 0x10, 0x30,
};

//wheel-right
byte wheel_right[][8] =
{
  0x18, 0x08, 0x08, 0xF9, 0x9F, 0x10, 0x10, 0x18,
  0x04, 0x42, 0xA4, 0x18, 0x18, 0x25, 0x42, 0x20,
  0x30, 0x10, 0x11, 0x1F, 0xF8, 0x88, 0x08, 0x0C,
};

//static emotion -left
byte static_emotion_left[][8] =
{
  0x44, 0x28, 0x10, 0x28, 0x44, 0x00, 0x00, 0x07,
  0x00, 0x00, 0x00, 0x38, 0x00, 0x00, 0x00, 0x07,
  0x38, 0x44, 0x54, 0x54, 0x44, 0x38, 0x00, 0x03,
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  0x38, 0x44, 0x42, 0x12, 0x04, 0x18, 0x03, 0x02
};

//static emotion -right
byte static_emotion_right[][8] =
{
  0x22, 0x14, 0x08, 0x14, 0x22, 0x00, 0x00, 0xE0,
  0x00, 0x1C, 0x1C, 0x1C, 0x00, 0x00, 0x20, 0xE0,
  0x1C, 0x22, 0x2A, 0x2A, 0x22, 0x1C, 0x00, 0xC0,
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  0x1C, 0x22, 0x42, 0x48, 0x20, 0x18, 0xC0, 0x40
};

//clear
byte clearEmotion[][8] = {
  0x00, 0x00, 0x00, 0x00, 0x00, 0x00, 0x00, 0x00,
};

Freenove_VK16K33 matrix = Freenove_VK16K33();  // The object that actually talks to the LED matrix hardware

int emotion_time_next = 0;  // millis() reading taken "now", each time we check the clock
int emotion_time_now = 0;   // millis() reading of when we last actually drew a new frame
int emotion_count = 0;      // Which frame of the current animation we're up to

// ----------------------------------------------------------------------------
// The functions below (eyesRotate, eyesBlink, eyesSmile, eyesCry, wheel) all
// follow the same pattern, which is a very useful trick for animating
// things WITHOUT using delay() (which would freeze the whole program):
//   1. Look at the clock (millis(), which counts milliseconds since power-on).
//   2. If enough time (delay_ms) has passed since the last frame, draw the
//      next frame and remember this new time.
//   3. Otherwise, do nothing this time - just return and try again next
//      time the function is called (once per loop(), very fast).
// This means you can call these functions constantly and they will animate
// smoothly at their own pace, while the rest of loop() keeps running too.
// ----------------------------------------------------------------------------

// eyesRotate: plays the "eyes looking around in a circle" animation.
// delay_ms controls how fast it spins (smaller = faster).
void eyesRotate(int delay_ms)
{
  int count = sizeof(eyeRotate1) / sizeof(eyeRotate1[0]);
  emotion_time_next = millis();
  if (emotion_time_next - emotion_time_now >= delay_ms)
  {
    emotion_time_now = emotion_time_next;
    matrix.showStaticArray(eyeRotate1[emotion_count], eyeRotate2[emotion_count]);
    emotion_count++;
    if (emotion_count >= count)
      emotion_count = 0;
  }
}

// eyesBlink: shows normal open eyes for a while (10 frames' worth), then
// plays through the closing/opening blink frames once, then repeats.
void eyesBlink(int delay_ms)
{
  emotion_time_next = millis();
  if (emotion_time_next - emotion_time_now >= delay_ms)
  {
    emotion_time_now = emotion_time_next;
    emotion_count++;
    if (emotion_count <= 10)
      matrix.showStaticArray(eyeBlink[0], eyeBlink[0]);
    else if (emotion_count > 10)
    {
      int count = sizeof(eyeBlink) / sizeof(eyeBlink[0]);
      matrix.showStaticArray(eyeBlink[(emotion_count - 11)], eyeBlink[(emotion_count - 11)]);
      if ((emotion_count - 10) >= count)
        emotion_count = 0;
    }
  }
}

// eyesSmile: plays a short 2-frame "smiling eyes" animation on a loop.
void eyesSmile(int delay_ms)
{
  int count = sizeof(eyeSmile) / sizeof(eyeSmile[0]);
  emotion_time_next = millis();
  if (emotion_time_next - emotion_time_now >= delay_ms)
  {
    emotion_time_now = emotion_time_next;
    matrix.showStaticArray(eyeSmile[emotion_count], eyeSmile[emotion_count]);
    emotion_count++;
    if (emotion_count >= count)
      emotion_count = 0;
  }
}

// eyesCry: plays a "crying" animation - tears appear one at a time under
// each eye, using two different frame arrays for the left/right matrix.
void eyesCry(int delay_ms)
{
  int count = sizeof(eyeCry1) / sizeof(eyeCry1[0]);
  emotion_time_next = millis();
  if (emotion_time_next - emotion_time_now >= delay_ms)
  {
    emotion_time_now = emotion_time_next;
    matrix.showStaticArray(eyeCry1[emotion_count], eyeCry2[emotion_count]);
    emotion_count++;
    if (emotion_count >= count)
      emotion_count = 0;
  }
}

// wheel: plays a spinning-wheel icon animation. mode 1 = left wheel design,
// mode 2 = right wheel design (used to show which way the car is turning).
void wheel(int mode, int delay_ms)
{
  if (mode == 1)
  {
    int count = sizeof(wheel_left) / sizeof(wheel_left[0]);
    emotion_time_next = millis();
    if (emotion_time_next - emotion_time_now >= delay_ms)
    {
      emotion_time_now = emotion_time_next;
      matrix.showStaticArray(wheel_left[emotion_count], wheel_left[emotion_count]);
      emotion_count++;
      if (emotion_count >= count)
        emotion_count = 0;
    }
  }
  if (mode == 2)
  {
    int count = sizeof(wheel_right) / sizeof(wheel_right[0]);
    emotion_time_next = millis();
    if (emotion_time_next - emotion_time_now >= delay_ms)
    {
      emotion_time_now = emotion_time_next;
      matrix.showStaticArray(wheel_right[emotion_count], wheel_right[emotion_count]);
      emotion_count++;
      if (emotion_count >= count)
        emotion_count = 0;
    }
  }
}

// staticEmtions: shows one single unmoving picture (chosen by `emotion`,
//0 to 20) from the big static_emotion_left/right picture collections -
// no animation, just draws that one frame and stops.
void staticEmtions(int emotion)
{
  int count = sizeof(static_emotion_left) / sizeof(static_emotion_left[0]);
  emotion = constrain(emotion, 0, count-1);
  matrix.showStaticArray(static_emotion_left[emotion], static_emotion_right[emotion]);
}

// clearEmtions: turns every pixel off, resets the animation frame counter
// back to 0 so the next animation starts fresh from its first frame.
void clearEmtions(void)
{
  emotion_count = 0;
  int count = sizeof(clearEmotion) / sizeof(clearEmotion[0]);
  for (int i = 0; i < count; i++)
  {
    matrix.showStaticArray(clearEmotion[i], clearEmotion[i]);
  }
}

// Emotion_Setup: connects to the matrix driver chip over I2C and sets its
// brightness. Call this once before using any of the other functions here.
void Emotion_Setup()
{
  matrix.init(EMOTION_ADDRESS);
  matrix.setBrightness(15);
  emotion_time_now = millis();
}

int emotion_task_mode = 0;  // The animation mode last picked by Emotion_SetMode()
// Emotion_Show: draws one frame of whichever animation `mode` selects.
// Called every time through loop() - since each of these sub-functions only
// actually updates the display once enough time has passed, calling this
// constantly is what makes the animation run smoothly.
void Emotion_Show(int mode)
{
  if (mode == 0)
    clearEmtions();
  else if (mode == 1)
    eyesRotate(150);
  else if (mode == 2)
    eyesBlink(100);
  else if (mode == 3)
    eyesSmile(200);
  else if (mode == 4)
    eyesCry(200);
  else if (mode == 5)
    wheel(2, 100);
  else if (mode == 6)
    wheel(1, 100);
}

// Emotion_SetMode: chooses which animation (0-6) Emotion_Show() will play.
// Passing 7 or higher instead shows a single random static picture, picked
// using the current clock time as a simple "random" number.
void Emotion_SetMode(int mode)
{
  if (mode <= 6)
    emotion_task_mode = mode;
  else if (mode >= 7)
  {
    // emotion_flag=0;
    emotion_task_mode = 7;
    int emotion_flag = millis() % 22;
    Serial.println("emotion_flag:"+String(emotion_flag));
    staticEmtions(emotion_flag);
  }
}
