#include <Arduino.h>
#include "Freenove_VK16K33_Lib.h"
#include "Freenove_4WD_Car_Emotion.h"

// ---------------------------------------------------------------------
// Below this point are lots of "byte arrays" like eyeRotate1[][8]. Each
// group of 8 bytes is ONE picture frame for the 8x8 LED matrix: row by
// row, top to bottom, and within each byte the bits say which of the 8
// LEDs in that row should light up. Several frames in a row form a short
// animation (eyes blinking, rotating, etc). You don't need to understand
// the hex numbers to follow the rest of the code — just know "this is a
// list of pictures". The interesting logic is in the functions further
// down (eyesRotate, eyesBlink, Emotion_Show, ...).
// ---------------------------------------------------------------------
Freenove_VK16K33 matrix = Freenove_VK16K33();
int emotion_time_next = 0;
int emotion_time_now = 0;
int emotion_count = 0;
int emotion_flag = 0;

//Turn eyes clockwise
byte eyeRotate1[][8] = {
  0x00,
  0x3C,
  0x4E,
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  0x00,
};

//Turn eyes counterclockwise
byte eyeRotate2[][8] = {
  0x00,
  0x3C,
  0x72,
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  0x00,
};

//Blink eyes
byte eyeBlink[][8] = {
  0x00,
  0x00,
  0x3C,
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  0x00,
};

//keep smile
byte eyeSmile[][8] = {
  0x00,
  0x00,
  0x18,
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  0x00,
};

//cry-left
byte eyeCry1[][8] = {
  0x00,
  0x00,
  0x7E,
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  0x00,
};

//cry-right
byte eyeCry2[][8] = {
  0x00,
  0x00,
  0x7E,
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  0x00,
};

//wheel-left
byte wheel_left[][8] = {
  0x18,
  0x10,
  0x10,
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  0x30,
};

//wheel-right
byte wheel_right[][8] = {
  0x18,
  0x08,
  0x08,
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  0x0C,
};

//static emotion -left
byte static_emotion_left[][8] = {
  0x44, 0x28, 0x10, 0x28, 0x44, 0x00, 0x00, 0x07,
  0x00, 0x00, 0x00, 0x38, 0x00, 0x00, 0x00, 0x07,
  0x38, 0x44, 0x54, 0x54, 0x44, 0x38, 0x00, 0x03,
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  0x38, 0x44, 0x42, 0x12, 0x04, 0x18, 0x03, 0x02
};

//static emotion -right
byte static_emotion_right[][8] = {
  0x22, 0x14, 0x08, 0x14, 0x22, 0x00, 0x00, 0xE0,
  0x00, 0x1C, 0x1C, 0x1C, 0x00, 0x00, 0x20, 0xE0,
  0x1C, 0x22, 0x2A, 0x2A, 0x22, 0x1C, 0x00, 0xC0,
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  0x1C, 0x22, 0x42, 0x48, 0x20, 0x18, 0xC0, 0x40
};

//clear
byte clearEmotion[][8] = {
  0x00,
  0x00,
  0x00,
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  0x00,
};

// eyesRotate(): plays the "rotating eyes" animation one frame at a time.
// Rather than using delay() (which would freeze the whole program), it
// checks how much time has passed since the last frame using millis() —
// this is a common Arduino trick for animating things without blocking
// everything else (like reading WiFi commands) from happening. Every time
// enough time (delay_ms) has passed, it shows the next frame and loops
// back to frame 0 once it reaches the end.
void eyesRotate(int delay_ms) {
  int count = sizeof(eyeRotate1) / sizeof(eyeRotate1[0]);
  emotion_time_next = millis();
  if (emotion_time_next - emotion_time_now >= delay_ms) {
    emotion_time_now = emotion_time_next;
    matrix.showStaticArray(eyeRotate1[emotion_count], eyeRotate2[emotion_count]);
    emotion_count++;
    if (emotion_count >= count)
      emotion_count = 0;
  }
}

// eyesBlink(): plays the "blinking" animation the same non-blocking way as
// eyesRotate() above — shows the "eyes open" frame for a while, then steps
// through the blink-closing frames once, then goes back to eyes-open.
void eyesBlink(int delay_ms) {
  emotion_time_next = millis();
  if (emotion_time_next - emotion_time_now >= delay_ms) {
    emotion_time_now = emotion_time_next;
    emotion_count++;
    if (emotion_count <= 10)
      matrix.showStaticArray(eyeBlink[0], eyeBlink[0]);
    else if (emotion_count > 10) {
      int count = sizeof(eyeBlink) / sizeof(eyeBlink[0]);
      matrix.showStaticArray(eyeBlink[(emotion_count - 11)], eyeBlink[(emotion_count - 11)]);
      if ((emotion_count - 10) >= count)
        emotion_count = 0;
    }
  }
}

// eyesSmile(): plays the looping "smiling eyes" animation frame by frame.
void eyesSmile(int delay_ms) {
  int count = sizeof(eyeSmile) / sizeof(eyeSmile[0]);
  emotion_time_next = millis();
  if (emotion_time_next - emotion_time_now >= delay_ms) {
    emotion_time_now = emotion_time_next;
    matrix.showStaticArray(eyeSmile[emotion_count], eyeSmile[emotion_count]);
    emotion_count++;
    if (emotion_count >= count)
      emotion_count = 0;
  }
}

// eyesCry(): plays the looping "crying eyes" animation frame by frame.
void eyesCry(int delay_ms) {
  int count = sizeof(eyeCry1) / sizeof(eyeCry1[0]);
  emotion_time_next = millis();
  if (emotion_time_next - emotion_time_now >= delay_ms) {
    emotion_time_now = emotion_time_next;
    matrix.showStaticArray(eyeCry1[emotion_count], eyeCry2[emotion_count]);
    emotion_count++;
    if (emotion_count >= count)
      emotion_count = 0;
  }
}

// wheel(): plays a spinning-wheel/gear icon animation, used while the car
// is turning. mode 1 shows the left-spin picture set, mode 2 the right-spin
// set — this is purely a visual indicator, it doesn't affect driving.
void wheel(int mode, int delay_ms) {
  if (mode == 1) {
    emotion_time_next = millis();
    if (emotion_time_next - emotion_time_now >= delay_ms) {
      emotion_time_now = emotion_time_next;
      int count = sizeof(wheel_left) / sizeof(wheel_left[0]);
      matrix.showStaticArray(wheel_left[emotion_count], wheel_left[emotion_count]);
      emotion_count++;
      if (emotion_count >= count)
        emotion_count = 0;
    }
  }
  if (mode == 2) {

    emotion_time_next = millis();
    if (emotion_time_next - emotion_time_now >= delay_ms) {
      emotion_time_now = emotion_time_next;
      int count = sizeof(wheel_right) / sizeof(wheel_right[0]);
      matrix.showStaticArray(wheel_right[emotion_count], wheel_right[emotion_count]);
      emotion_count++;
      if (emotion_count >= count)
        emotion_count = 0;
    }
  }
}

// staticEmtions(): shows ONE of the 21 fixed "emoji" pictures (no
// animation, just a single frame), chosen by the emotion number — see the
// list of 21 names in Freenove_4WD_Car_Emotion.h. constrain() stops an
// out-of-range number from reading past the end of the array.
void staticEmtions(int emotion) {
  int count = sizeof(static_emotion_left) / sizeof(static_emotion_left[0]);
  emotion = constrain(emotion, 0, count - 1);
  matrix.showStaticArray(static_emotion_left[emotion], static_emotion_right[emotion]);
}

// clearEmtions(): blanks the LED matrix (turns all dots off), used when
// switching between animations so old frames don't linger.
void clearEmtions(void) {
  emotion_time_next = millis();
  if (emotion_time_next - emotion_time_now >= 500) {
    emotion_time_now = emotion_time_next;
    emotion_count = 0;
    int count = sizeof(clearEmotion) / sizeof(clearEmotion[0]);
    for (int i = 0; i < count; i++)
      matrix.showStaticArray(clearEmotion[i], clearEmotion[i]);
  }
}

// Emotion_Setup(): starts up the HT16K33/VK16K33 LED matrix driver chip
// over I2C at the given address and sets it to full brightness. Called
// once we've detected the matrix is actually plugged in.
void Emotion_Setup(int address) {
  matrix.init(address);
  matrix.setBrightness(255);
  emotion_time_now = millis();
}

int emotion_task_mode = 0;
// Emotion_Show(): called every loop() iteration with the currently-active
// animation mode number, and steps that animation forward by one frame if
// enough time has passed. This is the function that actually keeps the
// face moving over time; Emotion_SetMode() below is what CHANGES which
// mode is active.
void Emotion_Show(int mode) {
  if (mode == 0)
    clearEmtions();
  else if (mode == 1)
    eyesRotate(150);
  else if (mode == 2)
    eyesCry(200);
  else if (mode == 3)
    eyesSmile(200);
  else if (mode == 4)  //right
    wheel(1, 100);
  else if (mode == 5)  //left
    wheel(2, 100);
  else if (mode == 6)
    eyesBlink(100);
  // else if (mode == 7)
  //   staticEmtions(emotion_flag);
}

extern int Check_Module_value;
// Emotion_SetMode(): called when the phone app sends a CMD_MATRIX_MOD
// command. Modes 0-6 pick one of the built-in animations (handled by
// Emotion_Show above). Mode 7+ instead shows a RANDOM one of the 21 fixed
// static emoji pictures — the "random" pick is just the current millis()
// clock value modulo 22, a simple trick to get an unpredictable number
// without a proper random-number generator.
void Emotion_SetMode(int mode) {
  if (Check_Module_value == MATRIX_IS_EXIST) {
    if (mode <= 6) {
      clearEmtions();
      emotion_task_mode = mode;
    } else if (mode >= 7) {
      emotion_task_mode = 7;
      emotion_flag = millis() % 22;
      Serial.println("emotion_flag:" + String(emotion_flag));
      staticEmtions(emotion_flag);
    }
  }
}
